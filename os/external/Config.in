## os/external/Config.in
```kconfig
menu "Open TV OS"
source "$BR2_EXTERNAL_OTV_PATH/package/otv-gateway/Config.in"
source "$BR2_EXTERNAL_OTV_PATH/package/otv-launcher/Config.in"
endmenu
```

## os/external/package/otv-gateway/Config.in
```kconfig
config BR2_PACKAGE_OTV_GATEWAY
	bool "otv-gateway"
	select BR2_PACKAGE_LIBDRM
	help
	  Open TV gateway port layer: the narrow device-specific interface
	  (DRM/KMS display, evdev input, time, device-service mock). Everything
	  above it is device-agnostic. Linux V4L2/ALSA/CEC interfaces are
	  declared but not implemented in milestone 1.
```

## os/external/package/otv-launcher/Config.in
```kconfig
config BR2_PACKAGE_OTV_LAUNCHER
	bool "otv-launcher"
	select BR2_PACKAGE_OTV_GATEWAY
	help
	  Open TV launcher: home, all apps, settings and overlays, rendered by
	  the otv UI toolkit on top of the gateway port layer.
```
